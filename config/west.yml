## config/west.yml
```yaml
manifest:
  remotes:
    - name: zmkfirmware
      url-base: https://github.com/zmkfirmware
    - name: caksoylar
      url-base: https://github.com/caksoylar
    - name: geeksville
      url-base: https://github.com/geeksville
    - name: beekeeb
      url-base: https://github.com/beekeeb
    - name: petejohanson
      url-base: https://github.com

  projects:
    - name: zmk
      remote: zmkfirmware
      import: app/west.yml
      revision: v0.3

    - name: chocofi
      remote: petejohanson
      revision: main

    - name: zmk-rgbled-widget
      remote: caksoylar
      revision: v0.3

    - name: zmk_driver_azoteq
      remote: beekeeb
      revision: main

    - name: zmk-input-zoom
      remote: beekeeb
      revision: main

  self:
    path: config
```
